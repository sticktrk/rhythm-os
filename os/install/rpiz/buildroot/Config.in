## os/install/rpiz/buildroot/Config.in
```kconfig
source "$BR2_EXTERNAL_RHYTHM_PATH/package/rhythm-cloudflared/Config.in"
source "$BR2_EXTERNAL_RHYTHM_PATH/package/rhythm-prebuilt/Config.in"
```

## os/install/rpiz/buildroot/configs/rhythm_rpiz_defconfig
```kconfig
BR2_arm=y
BR2_ARM_EABIHF=y
BR2_ARM_CPU_ARM1176JZF_S=y
BR2_DOWNLOAD_FORCE_CHECK_HASHES=y
BR2_GLOBAL_PATCH_DIR="board/raspberrypi/patches"
BR2_KERNEL_HEADERS_AS_KERNEL=y
BR2_PACKAGE_HOST_LINUX_HEADERS_CUSTOM_6_12=y
BR2_TOOLCHAIN_BUILDROOT_MUSL=y
BR2_TARGET_GENERIC_HOSTNAME="rhythm-rpiz"
BR2_TARGET_GENERIC_ISSUE="Rhythm OS Raspberry Pi Zero appliance"
BR2_TARGET_GENERIC_ROOT_PASSWD="rhythm"
BR2_ROOTFS_OVERLAY="$(BR2_EXTERNAL_RHYTHM_PATH)/board/rhythm/rpiz/rootfs-overlay"
BR2_ROOTFS_POST_BUILD_SCRIPT="$(BR2_EXTERNAL_RHYTHM_PATH)/board/rhythm/rpiz/post-build.sh"
BR2_ROOTFS_POST_IMAGE_SCRIPT="$(BR2_EXTERNAL_RHYTHM_PATH)/board/rhythm/rpiz/post-image.sh"
BR2_LINUX_KERNEL=y
BR2_LINUX_KERNEL_CUSTOM_TARBALL=y
BR2_LINUX_KERNEL_CUSTOM_TARBALL_LOCATION="$(call github,raspberrypi,linux,21b410140c47ffab5668399f6f143c7d7b935c8b)/linux-21b410140c47ffab5668399f6f143c7d7b935c8b.tar.gz"
BR2_LINUX_KERNEL_USE_DEFCONFIG=y
BR2_LINUX_KERNEL_DEFCONFIG="bcmrpi"
BR2_LINUX_KERNEL_DTS_SUPPORT=y
BR2_LINUX_KERNEL_INTREE_DTS_NAME="broadcom/bcm2708-rpi-zero broadcom/bcm2708-rpi-zero-w"
BR2_LINUX_KERNEL_CONFIG_FRAGMENT_FILES="$(BR2_EXTERNAL_RHYTHM_PATH)/board/rhythm/rpiz/linux.fragment"
BR2_LINUX_KERNEL_NEEDS_HOST_OPENSSL=y
BR2_PACKAGE_BUSYBOX=y
BR2_PACKAGE_BRCMFMAC_SDIO_FIRMWARE_RPI=y
BR2_PACKAGE_BRCMFMAC_SDIO_FIRMWARE_RPI_BT=y
BR2_PACKAGE_BRCMFMAC_SDIO_FIRMWARE_RPI_WIFI=y
BR2_PACKAGE_LINUX_FIRMWARE=y
BR2_PACKAGE_WIRELESS_REGDB=y
BR2_PACKAGE_KMOD=y
BR2_PACKAGE_KMOD_TOOLS=y
BR2_PACKAGE_XZ=y
BR2_PACKAGE_RPI_FIRMWARE=y
BR2_PACKAGE_RPI_FIRMWARE_BOOTCODE_BIN=y
BR2_PACKAGE_RPI_FIRMWARE_INSTALL_DTB_OVERLAYS=y
BR2_PACKAGE_RPI_FIRMWARE_VARIANT_PI=y
BR2_PACKAGE_NTP=y
BR2_PACKAGE_NTP_SNTP=y
BR2_PACKAGE_NTP_NTPD=y
BR2_PACKAGE_GLIB2=y
BR2_PACKAGE_DBUS=y
BR2_PACKAGE_AVAHI=y
BR2_PACKAGE_AVAHI_DAEMON=y
BR2_PACKAGE_BLUEZ5_UTILS=y
BR2_PACKAGE_BLUEZ5_UTILS_CLIENT=y
BR2_PACKAGE_BLUEZ5_UTILS_DEPRECATED=y
BR2_PACKAGE_WPA_SUPPLICANT=y
BR2_PACKAGE_WPA_SUPPLICANT_CLI=y
BR2_PACKAGE_WPA_SUPPLICANT_PASSPHRASE=y
BR2_PACKAGE_DROPBEAR=y
BR2_PACKAGE_HOST_DOSFSTOOLS=y
BR2_PACKAGE_HOST_GENIMAGE=y
BR2_PACKAGE_HOST_KMOD_XZ=y
BR2_PACKAGE_HOST_MTOOLS=y
BR2_TARGET_ROOTFS_EXT2=y
BR2_TARGET_ROOTFS_EXT2_4=y
BR2_TARGET_ROOTFS_EXT2_SIZE="192M"
BR2_PACKAGE_RHYTHM_PREBUILT=y
```

## os/install/rpiz/buildroot/package/rhythm-cloudflared/Config.in
```kconfig
config BR2_PACKAGE_RHYTHM_CLOUDFLARED
	bool "rhythm-cloudflared"
	help
	  Install the pinned Cloudflare Tunnel connector binary for the
	  Raspberry Pi Zero / Zero W ARMv6 appliance image.

	  https://github.com/cloudflare/cloudflared
```

## os/install/rpiz/buildroot/package/rhythm-prebuilt/Config.in
```kconfig
config BR2_PACKAGE_RHYTHM_PREBUILT
	bool "rhythm-prebuilt"
	help
	  Install the prebuilt Linux appliance binary from
	  dist/bin/rpiz into the target image.
```
